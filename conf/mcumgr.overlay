/*
 * MCUmgr DFU over USB CDC ACM
 *
 * The console CDC ACM UART (USB interface 0), shared by the mcumgr SMP
 * transport AND the serial console (both chosen below). It is also used by the
 * OTA bridge. The app build adds a second port for ZMK Studio
 * (conf/studio-usb.overlay); see conf/app.conf "ZMK Studio" and docs/usage.md.
 */

/ {
	chosen {
		zephyr,uart-mcumgr = &mcumgr_cdc_acm;
		zephyr,console = &mcumgr_cdc_acm;
	};
};

&zephyr_udc0 {
	mcumgr_cdc_acm: mcumgr_cdc_acm {
		compatible = "zephyr,cdc-acm-uart";
	};
};
